#ifndef ST7735_HW_SPI_H
#define ST7735_HW_SPI_H
#include <Arduino.h>
#include <SPI.h>
#include <pgmspace.h>

// 引脚定义（可根据实际硬件修改）
#define TFT_CS    0
#define TFT_DC    1
#define TFT_RST   2
#define TFT_MOSI  3
#define TFT_SCLK  4

// 屏幕参数
#define SCREEN_WIDTH  128
#define SCREEN_HEIGHT 128
#define COL_OFFSET 3
#define ROW_OFFSET 2

// 颜色定义
#define BLACK   0x0000
#define WHITE   0xFFFF
#define RED     0xF800
#define GREEN   0x07E0
#define BLUE    0x001F
#define YELLOW  0xFFE0
#define CYAN    0x07FF
#define MAGENTA 0xF81F

class ST7735_HW_SPI {
private:
  int cursorX = 0;
  int cursorY = 0;
  uint16_t textColor = WHITE;
  uint8_t textSize = 1;
  uint8_t rotation = 0;
  int _width = SCREEN_WIDTH;
  int _height = SCREEN_HEIGHT;
static const uint8_t font4x7[24][7] PROGMEM;
  // 8x8 ASCII字库
  static const uint8_t font8x8[95][8] PROGMEM;
  
  // 16x24大字体（用于数字）
  static const uint8_t font16x24[10][48] PROGMEM;  // 只存数字0-9
  
  void writeCommand(uint8_t cmd) {
    digitalWrite(TFT_DC, LOW);
    digitalWrite(TFT_CS, LOW);
    SPI.transfer(cmd);
    digitalWrite(TFT_CS, HIGH);
  }
  
  void writeData(uint8_t data) {
    digitalWrite(TFT_DC, HIGH);
    digitalWrite(TFT_CS, LOW);
    SPI.transfer(data);
    digitalWrite(TFT_CS, HIGH);
  }

  
  void setWindow(int x, int y, int w, int h) {
    int tx = x, ty = y;
    int tw = w, th = h;

    switch (rotation) {
      case 1:
        tx = y;
        ty = _height - x - w;
        swap(tw, th);
        break;
      case 2:
        tx = _width - x - w;
        ty = _height - y - h;
        break;
      case 3:
        tx = _width - y - h;
        ty = x;
        swap(tw, th);
        break;
    }

    if (tx < 0) { tw += tx; tx = 0; }
    if (tx + tw > _width)  tw = _width - tx;
    if (ty < 0) { th += ty; ty = 0; }
    if (ty + th > _height) th = _height - ty;
    if (tw <= 0 || th <= 0) return;

    writeCommand(0x2A);
    writeData(0x00); writeData(tx + COL_OFFSET);
    writeData(0x00); writeData(tx + tw - 1 + COL_OFFSET);

    writeCommand(0x2B);
    writeData(0x00); writeData(ty + ROW_OFFSET);
    writeData(0x00); writeData(ty + th - 1 + ROW_OFFSET);
  }

public:
  
  void setRotation(uint8_t r) {
  rotation = r % 4;
  writeCommand(0x36);
  
  uint8_t madctl = 0xC8;
  switch(rotation) {
    case 0: madctl = 0xC8; _width=SCREEN_WIDTH; _height=SCREEN_HEIGHT; break;
    case 1: madctl = 0x78; _width=SCREEN_HEIGHT; _height=SCREEN_WIDTH; break; 
    case 2: madctl = 0xA8; _width=SCREEN_WIDTH; _height=SCREEN_HEIGHT; break;
    case 3: madctl = 0x18; _width=SCREEN_HEIGHT; _height=SCREEN_WIDTH; break;
  }
  writeData(madctl);
}

 /*void drawFastHLine(int x, int y, int w, uint16_t color) {
    fillRect(x, y, w, 1, color);
  }*/

  void drawFastVLine(int x, int y, int h, uint16_t color) {
    fillRect(x, y, 1, h, color);
  }

  void drawRect(int x, int y, int w, int h, uint16_t color) {
    drawFastHLine(x, y, w, color);
    drawFastHLine(x, y + h - 1, w, color);
    drawFastVLine(x, y, h, color);
    drawFastVLine(x + w - 1, y, h, color);
  }

  void fillRect(int x, int y, int w, int h, uint16_t color) {
    setWindow(x, y, w, h);
    writeCommand(0x2C);
    digitalWrite(TFT_DC, HIGH);
    digitalWrite(TFT_CS, LOW);
    
    uint8_t hi = color >> 8;
    uint8_t lo = color & 0xFF;
    for (int i = 0; i < w * h; i++) {
      SPI.transfer(hi);
      SPI.transfer(lo);
    }
    digitalWrite(TFT_CS, HIGH);
  }
  
 
  void drawPixel(int x, int y, uint16_t color) {
    int tx = x, ty = y;
    switch (rotation) {
      case 1:
        tx = y;
        ty = _height - x - 1;
        break;
      case 2:
        tx = _width - x - 1;
        ty = _height - y - 1;
        break;
      case 3:
        tx = _width - y - 1;
        ty = x;
        break;
    }

    if (tx < 0 || tx >= _width || ty < 0 || ty >= _height) return;

    writeCommand(0x2A);
    writeData(0x00); writeData(tx + COL_OFFSET);
    writeData(0x00); writeData(tx + COL_OFFSET);
    
    writeCommand(0x2B);
    writeData(0x00); writeData(ty + ROW_OFFSET);
    writeData(0x00); writeData(ty + ROW_OFFSET);
    
    writeCommand(0x2C);
    digitalWrite(TFT_DC, HIGH);
    digitalWrite(TFT_CS, LOW);
    SPI.transfer(color >> 8);
    SPI.transfer(color & 0xFF);
    digitalWrite(TFT_CS, HIGH);
  }

  // 这个函数给恐龙用 → 自动180°翻转，解决上下左右颠倒
void drawImage(int x, int y, int w, int h, const uint16_t* img) {
  if (!img) return;
  setWindow(x, y, w, h);
  
  writeCommand(0x2C);
  digitalWrite(TFT_DC, HIGH);
  digitalWrite(TFT_CS, LOW);
    for (int j = h-1; j >= 0; j--) {        // 行反转
      for (int i = w-1; i >= 0; i--) {      // 列反转
        uint16_t color = pgm_read_word(&img[j * w + i]);
        SPI.transfer(color >> 8);
        SPI.transfer(color & 0xFF);
      }
    }
  
  
  digitalWrite(TFT_CS, HIGH);
}
  
  void drawChar(char c, int x, int y, uint16_t color) {
    int index = c - 32;
    if (index < 0 || index > 94) return;
    
    for (int row = 0; row < 8; row++) {
      uint8_t line = pgm_read_byte(&font8x8[index][row]);
      for (int col = 0; col < 8; col++) {
        if (line & (0x80 >> col)) {
          drawPixel(x + col, y + row, color);
        }
      }
    }
  }
void drawSmallChar(char c, int x, int y, uint16_t color) {
  int index = -1;
  
  // 数字 0-9
  if (c >= '0' && c <= '9') {
    index = c - '0';
  }
  // 运算符
  else {
    switch(c) {
      case '+': index = 10; break;
      case '-': index = 11; break;
      case '*': index = 12; break;
      case '/': index = 13; break;
      case '=': index = 14; break;
      case '%': index = 15; break;
      case '(': index = 16; break;
      case ')': index = 17; break;
      case '.': index = 18; break;
      case '^': index = 19; break;
      case 'V': index = 20; break;  // 根号用V表示
      case '<': index = 21; break;  // 左箭头
      case ' ': index = 22; break;  // 空格
      case 'R': index = 23; break;  // RET用R表示
      default: return;
    }
  }
  
  if (index < 0 || index > 23) return;
  
  if (x + 4 > SCREEN_WIDTH || y + 7 > SCREEN_HEIGHT) return;
  if (x < 0 || y < 0) return;
  
  for (int row = 0; row < 7; row++) {
    uint8_t line = pgm_read_byte(&font4x7[index][row]);
    for (int col = 0; col < 4; col++) {
      if (line & (0x08 >> col)) {
        drawPixel(x + col, y + row, color);
      }
    }
  }
}
// 绘制字符串
void drawSmallString(const char* str, int x, int y, uint16_t color) {
  int offset = 0;
  while (*str) {
    drawSmallChar(*str, x + offset, y, color);
    offset += 5; 
    str++;
  }
}
  // 镜像图片（专门给主界面背景用）
void drawImageMirror(int x, int y, int w, int h, const uint16_t* img) {
  if (!img) return;
  setWindow(x, y, w, h);
  
  writeCommand(0x2C);
  digitalWrite(TFT_DC, HIGH);
  digitalWrite(TFT_CS, LOW);

  // 水平镜像（只给背景用）
  for (int j = 0; j < h; j++) {
    for (int i = w-1; i >= 0; i--) {
      uint16_t color = pgm_read_word(&img[j * w + i]);
      SPI.transfer(color >> 8);
      SPI.transfer(color & 0xFF);
    }
  }
  
  digitalWrite(TFT_CS, HIGH);
}

// 显示30x30图片
void showImage30x30Fast(const uint8_t* img, int x, int y) {
  if (!img) return;
  
  // Image2LCD格式：前8字节是头信息
  int idx = 8;
  const int width = 30;
  const int height = 30;
  
  for (int row = 0; row < height; row++) {
    for (int col = 0; col < width; col++) {
      uint8_t high = img[idx++];
      uint8_t low = img[idx++];
      uint16_t color = (high << 8) | low;
      drawPixel(x + col, y + row, color); 
    }
  }
}
  void drawLargeDigit(char c, int x, int y, uint16_t color) {
    if (c < '0' || c > '9') return;
    int index = c - '0';
    
    if (x < 0 || x + 16 > _width || y < 0 || y + 24 > _height) return;
    
    for (int row = 0; row < 24; row++) {
      uint16_t line = (pgm_read_byte(&font16x24[index][row*2]) << 8) | 
                        pgm_read_byte(&font16x24[index][row*2+1]);
      for (int col = 0; col < 16; col++) {
        if (line & (0x8000 >> col)) {
          drawPixel(x + col, y + row, color);
        }
      }
    }
  }
  
  void drawString(const char* str, int x, int y, uint16_t color) {
    int offset = 0;
    while (*str) {
      drawChar(*str, x + offset, y, color);
      offset += 8;
      str++;
    }
  }
  
  void drawNumber(int num, int x, int y, uint16_t color) {
    char buf[10];
    sprintf(buf, "%d", num);
    drawString(buf, x, y, color);
  }
  
  void setCursor(int x, int y) {
    cursorX = x;
    cursorY = y;
  }

  void setTextColor(uint16_t color) {
    textColor = color;
  }

  void setTextSize(uint8_t size) {
    textSize = size;
  }

  void print(const char* str) {
    drawString(str, cursorX, cursorY, textColor);
    cursorX += strlen(str) * 8 * textSize;
  }

  void print(int num) {
    char buf[10];
    //sprintf(buf, "%d", num);
    print(buf);
  }

  void println(const char* str) {
    print(str);
    cursorX = 0;
    cursorY += 8 * textSize;
  }

  void println() {
    cursorX = 0;
    cursorY += 8 * textSize;
  }

  void fillScreen(uint16_t color) {
    fillRect(0, 0, _width, _height, color);
  }
 
void fillCircle(int centerX, int centerY, int radius, uint16_t color) {
 
  if (centerX < -radius || centerX >= _width + radius || 
      centerY < -radius || centerY >= _height + radius) return;
  
  int x = radius;
  int y = 0;
  int err = 0;
  
  while (x >= y) {
    // 计算绘制范围并裁剪到屏幕内
    int x1 = max(centerX - x, 0);
    int x2 = min(centerX + x, _width - 1);
    if (x2 >= x1) {
      drawFastHLine(x1, centerY + y, x2 - x1 + 1, color);
      drawFastHLine(x1, centerY - y, x2 - x1 + 1, color);
    }
    
    x1 = max(centerX - y, 0);
    x2 = min(centerX + y, _width - 1);
    if (x2 >= x1) {
      drawFastHLine(x1, centerY + x, x2 - x1 + 1, color);
      drawFastHLine(x1, centerY - x, x2 - x1 + 1, color);
    }
    
    y += 1;
    err += 1 + 2 * y;
    if (2 * (err - x) + 1 > 0) {
      x -= 1;
      err += 1 - 2 * x;
    }
  }
}

void drawLine(int x0, int y0, int x1, int y1, uint16_t color) {
 
  int dx = abs(x1 - x0);
  int dy = -abs(y1 - y0);
  int sx = x0 < x1 ? 1 : -1;
  int sy = y0 < y1 ? 1 : -1;
  int err = dx + dy;
  int e2;
  
  while (true) {
    drawPixel(x0, y0, color);
    if (x0 == x1 && y0 == y1) break;
    e2 = 2 * err;
    if (e2 >= dy) {
      err += dy;
      x0 += sx;
    }
    if (e2 <= dx) {
      err += dx;
      y0 += sy;
    }
  }
}


void drawFastHLine(int x, int y, int w, uint16_t color) {
  if (w <= 0) return;
  fillRect(x, y, w, 1, color);
}


void fillTriangle(int x0, int y0, int x1, int y1, int x2, int y2, uint16_t color) {
  // 按 Y 坐标排序
  if (y0 > y1) { swap(x0, x1); swap(y0, y1); }
  if (y1 > y2) { swap(x1, x2); swap(y1, y2); }
  if (y0 > y1) { swap(x0, x1); swap(y0, y1); }
  
  // 如果三角形是平的或高度为0
  if (y0 == y2) return;
  
  // 使用固定点数计算避免浮点运算
  int dx1 = (y1 - y0 != 0) ? ((x1 - x0) << 10) / (y1 - y0) : 0;
  int dx2 = (y2 - y0 != 0) ? ((x2 - x0) << 10) / (y2 - y0) : 0;
  int dx3 = (y2 - y1 != 0) ? ((x2 - x1) << 10) / (y2 - y1) : 0;
  
  int curX1 = x0 << 10;
  int curX2 = x0 << 10;
  
  // 绘制上半部分
  for (int y = y0; y < y1; y++) {
    int startX = curX1 >> 10;
    int endX = curX2 >> 10;
    if (startX > endX) swap(startX, endX);
    
    // 裁剪到屏幕内
    startX = max(startX, 0);
    endX = min(endX, _width - 1);
    if (endX >= startX && y >= 0 && y < _height) {
      drawFastHLine(startX, y, endX - startX + 1, color);
    }
    
    curX1 += dx1;
    curX2 += dx2;
  }
  
  // 绘制下半部分
  curX1 = x1 << 10;
  for (int y = y1; y <= y2; y++) {
    int startX = curX1 >> 10;
    int endX = curX2 >> 10;
    if (startX > endX) swap(startX, endX);
    
    startX = max(startX, 0);
    endX = min(endX, _width - 1);
    if (endX >= startX && y >= 0 && y < _height) {
      drawFastHLine(startX, y, endX - startX + 1, color);
    }
    
    curX1 += dx3;
    curX2 += dx2;
  }
}

void drawCircle(int centerX, int centerY, int radius, uint16_t color) {
  int x = radius;
  int y = 0;
  int err = 0;
  
  while (x >= y) {
    drawPixel(centerX + x, centerY + y, color);
    drawPixel(centerX + y, centerY + x, color);
    drawPixel(centerX - y, centerY + x, color);
    drawPixel(centerX - x, centerY + y, color);
    drawPixel(centerX - x, centerY - y, color);
    drawPixel(centerX - y, centerY - x, color);
    drawPixel(centerX + y, centerY - x, color);
    drawPixel(centerX + x, centerY - y, color);
    
    y += 1;
    err += 1 + 2*y;
    if (2*(err - x) + 1 > 0) {
      x -= 1;
      err += 1 - 2*x;
    }
  }
}


void drawTriangle(int x0, int y0, int x1, int y1, int x2, int y2, uint16_t color) {
  drawLine(x0, y0, x1, y1, color);
  drawLine(x1, y1, x2, y2, color);
  drawLine(x2, y2, x0, y0, color);
}
  void begin() {
    pinMode(TFT_CS, OUTPUT);
    pinMode(TFT_DC, OUTPUT);
    pinMode(TFT_RST, OUTPUT);
    
    digitalWrite(TFT_CS, HIGH);
    digitalWrite(TFT_DC, HIGH);
    
    digitalWrite(TFT_RST, LOW);
    delay(10);
    digitalWrite(TFT_RST, HIGH);
    delay(120);
    
    SPI.begin(TFT_SCLK, -1, TFT_MOSI, TFT_CS);
    SPI.beginTransaction(SPISettings(80000000, MSBFIRST, SPI_MODE0));
    
    writeCommand(0x11); delay(120);
    writeCommand(0x29); delay(50);
    writeCommand(0x3A); writeData(0x05);
    
    setRotation(0);
    
    writeCommand(0x2A);
    writeData(0x00); writeData(COL_OFFSET);
    writeData(0x00); writeData(127 + COL_OFFSET);
    
    writeCommand(0x2B);
    writeData(0x00); writeData(ROW_OFFSET);
    writeData(0x00); writeData(127 + ROW_OFFSET);
    // 在初始化函数中添加
writeCommand(0xE0); // 正Gamma
writeData(0x02);
writeData(0x1C);
writeData(0x07);
writeData(0x12);
writeData(0x37);
writeData(0x32);
writeData(0x29);
writeData(0x2D);
writeData(0x29);
writeData(0x25);
writeData(0x2B);
writeData(0x39);
writeData(0x00);
writeData(0x01);
writeData(0x03);
writeData(0x10);

writeCommand(0xE1); // 负Gamma
writeData(0x03);
writeData(0x1D);
writeData(0x07);
writeData(0x06);
writeData(0x2E);
writeData(0x2C);
writeData(0x29);
writeData(0x2D);
writeData(0x2E);
writeData(0x2E);
writeData(0x37);
writeData(0x3F);
writeData(0x00);
writeData(0x00);
writeData(0x02);
writeData(0x10);
  }

  void swap(int &a, int &b) {
    int t = a; a = b; b = t;
  }
};

const uint8_t ST7735_HW_SPI::font8x8[95][8] PROGMEM = {
  {0x00,0x00,0x00,0x00,0x00,0x00,0x00,0x00}, //
  {0x18,0x18,0x18,0x18,0x18,0x00,0x18,0x00}, //!
  {0x6C,0x6C,0x6C,0x00,0x00,0x00,0x00,0x00}, //"
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  {0x3B,0x6E,0x00,0x00,0x00,0x00,0x00,0x00}  //~
};

const uint8_t ST7735_HW_SPI::font16x24[10][48] PROGMEM = {
  {0x00,0x00,0x00,0x00,0x00,0x00,0x0F,0x80,0x1F,0xC0,0x38,0xE0,0x30,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0x00,0x00},
  {0x00,0x00,0x00,0x00,0x00,0x00,0x03,0x00,0x03,0x00,0x07,0x00,0x0F,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0x00,0x00},
  {0x00,0x00,0x00,0x00,0x00,0x00,0x1F,0x80,0x3F,0xC0,0x70,0xE0,0x60,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0x00,0x00},
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  {0x00,0x00,0x00,0x00,0x00,0x00,0x1F,0x80,0x3F,0xC0,0x70,0xE0,0x60,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0x00,0x00}
};

// 扩展支持：0-9, +, -, *, /, =, %, (, ), ., ^, √, ←, RET
const uint8_t ST7735_HW_SPI::font4x7[24][7] PROGMEM = {
  // 0-9 (索引0-9)
  {0x06, 0x09, 0x09, 0x09, 0x09, 0x09, 0x06},
  {0x02, 0x06, 0x02, 0x02, 0x02, 0x02, 0x07},
  {0x06, 0x09, 0x01, 0x02, 0x04, 0x08, 0x0F},
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  {0x06, 0x09, 0x09, 0x07, 0x01, 0x02, 0x0C},
  
  // 10-17: 原有符号
  {0x00, 0x02, 0x02, 0x07, 0x02, 0x02, 0x00}, // + 
  {0x00, 0x00, 0x00, 0x07, 0x00, 0x00, 0x00}, // -
  {0x00, 0x05, 0x02, 0x05, 0x00, 0x00, 0x00}, // *
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  {0x04, 0x02, 0x01, 0x01, 0x01, 0x02, 0x04}, // )
  
  // 18: 小数点 '.'
  {0x00, 0x00, 0x00, 0x00, 0x00, 0x02, 0x02},
  // 19: 乘方 '^'
  {0x02, 0x05, 0x02, 0x00, 0x00, 0x00, 0x00},
  // 20: 根号 '√' (用v代替)
  {0x00, 0x04, 0x04, 0x04, 0x05, 0x02, 0x00},
  // 21: 左箭头 '<-'
  {0x02, 0x04, 0x08, 0x0F, 0x08, 0x04, 0x02},
  // 22: 空格 ' '
  {0x00, 0x00, 0x00, 0x00, 0x00, 0x00, 0x00},
  // 23: R (RET)
  {0x0E, 0x11, 0x11, 0x0E, 0x0A, 0x11, 0x00}
};
#endif